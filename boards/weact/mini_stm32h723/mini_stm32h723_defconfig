## boards/weact/mini_stm32h723/mini_stm32h723_defconfig
```kconfig
# Copyright (c) Charles Dias
# SPDX-License-Identifier: Apache-2.0

# Enable MPU (Memory Protection Unit)
CONFIG_ARM_MPU=y

# Enable hardware stack protection for runtime safety
CONFIG_HW_STACK_PROTECTION=y

# Enable UART driver
CONFIG_SERIAL=y

# Enable console over UART
CONFIG_CONSOLE=y

# Enable GPIO subsystem
CONFIG_GPIO=y

# Set USB CDC ACM log level to off (prevent recursion issues with logging)
CONFIG_USB_CDC_ACM_LOG_LEVEL_OFF=y

# Enable USB device stack
CONFIG_USB_DEVICE_STACK=y
```
